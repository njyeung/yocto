## conf/bblayers.conf
```bitbake
# POKY_BBLAYERS_CONF_VERSION is increased each time build/conf/bblayers.conf
# changes incompatibly meta-python
POKY_BBLAYERS_CONF_VERSION = "2"

BBPATH = "${TOPDIR}"
BBFILES ?= ""

BBLAYERS ?= " \
  /home/nickjyeung/Desktop/yocto/poky/meta \
  /home/nickjyeung/Desktop/yocto/poky/meta-poky \
  /home/nickjyeung/Desktop/yocto/poky/meta-yocto-bsp \
  /home/nickjyeung/Desktop/yocto/poky/meta-raspberrypi \
  /home/nickjyeung/Desktop/yocto/poky/meta-openembedded/meta-oe \
  /home/nickjyeung/Desktop/yocto/poky/meta-openembedded/meta-python \
  /home/nickjyeung/Desktop/yocto/poky/meta-de.sigma-chemnitz \
  /home/nickjyeung/Desktop/yocto/poky/meta-selinux \
  /home/nickjyeung/Desktop/yocto/poky/de.ensc.bpi-router/meta-core \
  "
 
```
